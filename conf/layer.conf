## conf/layer.conf
```bitbake
# SPDX-FileCopyrightText: none
# SPDX-License-Identifier: CC0-1.0

# We have a conf and classes directory, add to BBPATH
BBPATH .= ":${LAYERDIR}"

# We have recipes-* directories, add to BBFILES
BBFILES += " \
    ${LAYERDIR}/recipes-*/*.bb \
    ${LAYERDIR}/recipes-*/*/*.bb \
    ${LAYERDIR}/recipes-*/*/*/*.bb \
    ${LAYERDIR}/recipes-*/*.bbappend \
    ${LAYERDIR}/recipes-*/*/*.bbappend \
    ${LAYERDIR}/recipes-*/*/*/*.bbappend \
"

BBFILE_COLLECTIONS += "kde"
BBFILE_PATTERN_kde = "^${LAYERDIR}/"
BBFILE_PRIORITY_kde = "8"

LAYERDEPENDS_kde += "openembedded-layer kf6 qt6-layer"
LAYERSERIES_COMPAT_kde = "scarthgap styhead"
```
